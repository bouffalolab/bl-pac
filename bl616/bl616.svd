# BL616/BL618 register map
Vendor: Bouffalo Lab; File version: 1.0
Bouffalo BL616/BL618 chip series
Registers are 32-bit, read-write, reset 0x0 unless marked. A register's access mark holds for its fields unless they carry their own. Offsets are from the block's base; lines under a group give offsets from that group; [hi:lo] are bit positions; {n}, {i} and the like mark numbered series; 'fields as' and 'values as' point back to an identical list; <NAME> marks a mode.

## Memory map
0x20000000 GLB size 0x1000 — Global configuration register
0x20002000 GPIP size 0x1000 — Generic DAC and ADC interface control
0x20002C00 AGC size 0x1000 — Automatic Gain Control
0x20004000 SEC size 0x1000 — Digest, Encryption and Signing accelerator
0x20005000 PERMIT size 0x1000 — Peripheral and memory access permission
{0x2000A000+0x100*n} UART[{n}] (n=0..1) size 0x100 — Universal Asynchronous Receiver Transmitter
{0x2000A200+0x100*n} SPI[{n}] (n=0..0) size 0x100 — Serial Peripheral Interface
{0x2000A300+0x600*n} I2C[{n}] (n=0..1) size 0x100 — Inter-Integrated Circuit bus
0x2000A400 PWM size 0x100 — Pulse-Width Modulation module
0x2000A500 TIMER size 0x1000 — Timer control
0x2000A600 IR size 0x100 — Infrared receiver module
0x2000A700 CRC size 0x100 — Checksum peripheral
0x2000A800 DBI size 0x100 — MIPI Display Bus Interface
0x2000AA00 ISO11898 size 0x100 — ISO 11898 communication protocol
0x2000AB00 I2S size 0x100 — Inter-IC Sound controller
0x2000AC00 AUADC size 0x100 — Analog-to-Digital or Pulse-Density audio input
0x2000B000 FLASH size 0x100 — Quad Serial Flash control
0x2000C000 DMA size 0x1000 — Direct Memory Access module
0x2000D000 SDU size 0x100 — Secure Digital User interface
0x2000E000 PDS size 0x1000 — Power-Down Sleep control
0x2000F000 HBN size 0x800 — Hibernate (Deep sleep) control
0x20052000 PSRAM size 0x100 — Pseudo Static Random Access Memory control
0x20055000 AUDAC size 0x1000 — Pulse-Width or Digital-to-Analog audio output
0x20056000 EFUSE size 0x1000 — eFuse memory control
{0x20057000+0x1000*n} DVP[{n}] (n=0..0) size 0x1000 — Digital Video Port control
0x20059000 MJPEG size 0x1000 — Motion JPEG encoder
0x20060000 SDH size 0x1000 — Secure Digital host control
0x20070000 EMAC size 0x1000 — Ethernet Media Access Control
0x20072000 USB size 0x1000 — Universal Serial Bus host

## GPIP — Generic DAC and ADC interface control
Base 0x20002000
0x00 gpadc_config — Generic Analog-to-Digital Converter register
0x04 gpadc_dma_read — DMA data output of Generic Analog-to-Digital Converter
0x40 gpdac_config — Generic Digital-to-Analog Converter register
0x44 gpdac_dma_config — Digital-to-Analog Converter DMA configuration
0x48 gpdac_dma_write — DMA data input of Generic Digital-to-Analog Converter
0x4C gpdac_fifo_state — Transmit FIFO state of Generic Digital-to-Analog Converter

## AGC — Automatic Gain Control
Base 0x20002C00
Same registers: SEC 0x20004000, PERMIT 0x20005000, TIMER 0x2000A500, DBI 0x2000A800, ISO11898 0x2000AA00, FLASH 0x2000B000, SDU 0x2000D000, PSRAM 0x20052000, EFUSE 0x20056000, MJPEG 0x20059000, SDH 0x20060000
0x00 todo — ??

## DVP[{n}] — Digital Video Port control
Base 0x20057000; array of 1, step 0x1000
Registers as AGC.

## SPI[{n}] — Serial Peripheral Interface
Base 0x2000A200; array of 1, step 0x100
0x00 config — Function configuration register
0x04 interrupt_state — Interrupt enables, masks and states
0x08 bus_busy — Bus busy state indicator
0x10 period_control — Duration of control signals
0x14 period_interval — Interval bitween frames
0x18 ignore_index — Receive ignore index configuration
0x1C timeout — Slave mode transmit timeout values
0x80 fifo_config_0 — FIFO configuration register 0
0x84 fifo_config_1 — FIFO configuration register 1
0x88 data_write — FIFO write data register
0x8C data_read — FIFO read data register

## Licence text in the file
Copyright (c) 2023 Bouffalo Lab bl616-pac is licensed under Mulan PSL v2. You can use this software according to the terms and conditions of the Mulan PSL v2. You may obtain a copy of Mulan PSL v2 at: http://license.coscl.org.cn/MulanPSL2 THIS SOFTWARE IS PROVIDED ON AN "AS IS" BASIS, WITHOUT WARRANTIES OF ANY KIND, EITHER EXPRESS OR IMPLIED, INCLUDING BUT NOT LIMITED TO NON-INFRINGEMENT, MERCHANTABILITY OR FIT FOR A PARTICULAR PURPOSE. See the Mulan PSL v2 for more details.
